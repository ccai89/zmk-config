## config/boards/shields/dactyl_manuform_5x6/dactyl_manuform_5x7/Kconfig.defconfig
```kconfig
if SHIELD_DACTYL_MANUFORM_5x7_LEFT

    config ZMK_KEYBOARD_NAME
        default "CCAI-DACTYL-L"

    config ZMK_SPLIT_BLE_ROLE_CENTRAL
        default y

endif

if SHIELD_DACTYL_MANUFORM_5x7_RIGHT

    config ZMK_KEYBOARD_NAME
        default "CCAI-DACTYL-R"

endif

if SHIELD_DACTYL_MANUFORM_5x7_LEFT || SHIELD_DACTYL_MANUFORM_5x7_RIGHT

    config ZMK_SPLIT
        default y

endif
```
